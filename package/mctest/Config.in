## package/mctest/Config.in
```kconfig
config BR2_PACKAGE_MCTEST
	bool "mctest"
	help
	  https://github.com/sonicyang/mctest
```

## package/systemtap/Config.in
```kconfig
config BR2_PACKAGE_SYSTEMTAP
	bool "systemtap"
    select BR2_PACKAGE_ELFUTILS
	help
	  SystemTap Package

	  https://sourceware.org/systemtap/wiki
```

## package/wastedcores/Config.in
```kconfig
config BR2_PACKAGE_WASTEDCORES
	bool "wastedcores"
	help
	  https://github.com/sonicyang/wastedcores

if BR2_PACKAGE_WASTEDCORES

config BR2_PACKAGE_WASTEDCORES_NUM_CPU
    default 4
	string "Target CPU count"

config BR2_PACKAGE_WASTEDCORES_MAX_SAMPLE
    default 100000000
	string "Max Entries"
	help
        Memory required is 32bytes * Entries Count

config BR2_PACKAGE_WASTEDCORES_EXTRA
   bool "Enable Extra Profiling"
	help
        Event 231 is context switching, with data cpu, pid(in 4 byte slots)

endif
```
